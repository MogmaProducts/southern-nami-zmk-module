## boards/shields/southernNami/Kconfig.defconfig
```kconfig
if SOUTHERN_NAMI
config ZMK_KEYBOARD_NAME
    default "Southern // NAMI"

config ZMK_STUDIO
    default y

config SPI
    default y

endif
```
